/*
 * Copyright (C) 2015 GuangZhou Tronlong co., LTD - http://www.tronlong.com
 *
 * This program is free software; you can redistribute it and/or modify
 * it under the terms of the GNU General Public License version 2 as
 * published by the Free Software Foundation.
 */

/* Common device tree for TL437x-EasyEVM/TL437x-EVM/TL437xF-EVM */

#include "tl437x-common.dtsi"

&usb1 {
	dr_mode = "peripheral";
	status = "okay";
};
